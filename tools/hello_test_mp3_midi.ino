/*
      YET-INTERNET-RADIO-WITH-ESP32
      *** MP3 & MIDI TEST *** 
*/

#include <Arduino.h>

#include <Adafruit_VS1053.h>    // don't forget to connect miso/mosi/sck
#define VS_CS     5       // VS1053 chip select pin (output) = Control Chip Select Pin (for accessing SPI Control/Status registers) --> XCS
#define VS_DCS    33      // VS1053 Data/chip/command select pin (output) --> XDSV sau XDCS
#define VS_DREQ   35      // VS1053 Data request, ideally an Interrupt pin: Player asks for more  data, --> DREQ
#define VS_RESET  -1      // VS1053 reset pin (output) --> XRET ; not necessary with esp32, wired to EN pin on ESP32
#define CARDCS    -1      // SD Card command select pin (output); not used
Adafruit_VS1053_FilePlayer vsPlayer = Adafruit_VS1053_FilePlayer(VS_RESET, VS_CS, VS_DCS, VS_DREQ, CARDCS);

#define VS_BUFFER_SIZE      32       // how many bytes are sent to VS1053 into one batch

byte mp3[] = {
    0xff, 0xe3, 0x18, 0xc4, 0x00, 0x07, 0xf8, 0x01, 0xd9, 0x70, 0x08, 0x44, 0x94, 0xcd, 0x7d, 0x52, 0x1a, 0xe9, 0xa0, 0x58, 0xce, 0x87, 0xed, 0x76, 
    0x6b, 0xf4, 0xf9, 0xbf, 0xe2, 0xc6, 0x3f, 0xbb, 0xff, 0xe9, 0x7f, 0xff, 0xf5, 0xa0, 0x23, 0xfc, 0x98, 0x11, 0xbf, 0xfa, 0x90, 0xb3, 0x43, 0x63, 
    0xf5, 0xb4, 0xdb, 0x31, 0xdc, 0x86, 0xcd, 0xc9, 0xbf, 0x39, 0xa3, 0xe7, 0x00, 0xff, 0xd3, 0x4f, 0xe7, 0x3f, 0x21, 0x7f, 0xff, 0xf5, 0x1c, 0x2e, 
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    0x1a, 0x4c, 0x41, 0x4d, 0x45, 0x33, 0x2e, 0x39, 0x39, 0x2e, 0x35, 0x55, 0x55, 0x55, 0x55, 0x55, 0x55, 0x55, 0x55, 0x55, 0x55, 0x55, 0x55, 0x55 };

byte midi[] = {
    0x4D,0x54,0x68,0x64,0x00,0x00,0x00,0x06,0x00,0x00,0x00,0x01,0x01,0xE0,0x4D,0x54,0x72,0x6B,0x00,0x00,0x02,0xC3,0x00,0xFF,0x51,0x03,0x07,0xA1,0x20,0x00,0x90,0x3C,
    0x64,0x78,0x80,0x3C,0x64,0x00,0x90,0x3C,0x64,0x82,0x68,0x80,0x3C,0x64,0x00,0x90,0x3C,0x64,0x78,0x80,0x3C,0x64,0x00,0x90,0x41,0x64,0x83,0x60,0x80,0x41,0x64,0x00,
    0x90,0x41,0x64,0x83,0x60,0x80,0x41,0x64,0x00,0x90,0x43,0x64,0x83,0x60,0x80,0x43,0x64,0x00,0x90,0x43,0x64,0x83,0x60,0x80,0x43,0x64,0x00,0x90,0x48,0x64,0x85,0x50,
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    0x80,0x41,0x64,0x00,0x90,0x41,0x64,0x83,0x60,0x80,0x41,0x64,0x00,0x90,0x40,0x64,0x83,0x60,0x80,0x40,0x64,0x00,0xFF,0x2F,0x00 };


void playArray(byte arr[], int endPointer) {

  unsigned int tmpPointer = 0;
  Serial.printf("--> Playing %u bytes of data.\r\n", endPointer); 
  
  byte tmp[VS_BUFFER_SIZE];
  while (tmpPointer <= endPointer) {    
         for (int i = 0; i < VS_BUFFER_SIZE; i++) { tmp[i] = arr[i+tmpPointer] ;  } 
         while (!vsPlayer.readyForData()) { yield(); }      // wait a few ms to finish what's currently playinh
         if (digitalRead(VS_DREQ) == HIGH) {                // if VS is ready for feeding data
               vsPlayer.playData(tmp, VS_BUFFER_SIZE);
               tmpPointer = tmpPointer + VS_BUFFER_SIZE;
               }
   }
}

void setup() {
  
  Serial.begin(115200);
  if (!vsPlayer.begin()) { Serial.println(F("--> ERROR: VS1053 not found.")); while(1) {} } 
  vsPlayer.softReset(); delay(150); vsPlayer.setVolume(0, 0); // 0 = max vol

  playArray(mp3, sizeof(mp3)); 
  delay(1000);
  playArray(midi, sizeof(midi));

}

void loop() {  }
